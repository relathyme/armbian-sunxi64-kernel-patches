/dts-v1/;
/plugin/;

/ {
	compatible = "xunlong,orangepi-zero3";
	fragment@0 {
		target = <&gpu>;
		__overlay__ {
			status = "disabled";
		};
	};

	fragment@1 {
		target = <&de>;
		__overlay__ {
			status = "disabled";
		};
	};

	fragment@2 {
		target-path = "/soc/video-codec@1c0e000";
		__overlay__ {
			status = "disabled";
		};
	};
};
