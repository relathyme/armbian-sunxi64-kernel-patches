## misc/usr/local/etc/uImage-spi.its
```
/dts-v1/;

/ {
	description = "fit";
	#address-cells = <1>;
	images {
		kernel-1 {
			description = "kernel";
			data = /incbin/("./Image.lzma");
			type = "kernel";
			arch = "arm64";
			os = "linux";
			compression = "lzma";
			load = <0x40080000>;
			entry = <0x40080000>;
			hash-1 {
				algo = "sha1";
			};
		};
		fdt-1 {
			description = "fdt";
			data = /incbin/("./dt.dtb");
			type = "flat_dt";
			arch = "arm64";
			compression = "none";
			hash-1 {
				algo = "sha1";
			};
		};
	};
	configurations {
		default = "conf-1";
		conf-1 {
			description = "default";
			kernel = "kernel-1";
			fdt = "fdt-1";
		};
	};
};
```

## misc/usr/local/etc/uImage-template.its
```
/dts-v1/;

/ {
	description = "Linux version %KVER%";
	#address-cells = <1>;
	images {
		kernel-1 {
			description = "kernel";
			data = /incbin/("%VMLINUZ%");
			type = "kernel";
			arch = "arm64";
			os = "linux";
			compression = "gzip";
			load = <0x40080000>;
			entry = <0x40080000>;
			hash-1 {
				algo = "sha1";
			};
		};
		ramdisk-1 {
			description = "ramdisk";
			data = /incbin/("%INITRD%");
			type = "ramdisk";
			arch = "arm64";
			os = "linux";
			compression = "gzip";
			load = <0x4ff00000>;
			entry = <0x4ff00000>;
			hash-1 {
				algo = "sha1";
			};
		};
	};
	configurations {
		default = "conf-1";
		conf-1 {
			description = "default";
			kernel = "kernel-1";
			ramdisk = "ramdisk-1";
		};
	};
};
```
